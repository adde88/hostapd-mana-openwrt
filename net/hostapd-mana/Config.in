## net/hostapd-mana/Config.in
```kconfig
config MANA_RFKILL_SUPPORT
	bool "Add rfkill support"
	depends on PACKAGE_wpa-supplicant || \
		PACKAGE_wpa-supplicant-mini || \
		PACKAGE_wpad || \
		PACKAGE_wpad-mini
	default n

config MANA_MSG_MIN_PRIORITY
	int "Minimum debug message priority"
	default 2
	help
	  Useful values are:
	    0 = all messages
		1 = raw message dumps
		2 = most debugging messages
		3 = info messages
		4 = warnings
		5 = errors

config MANA_DRIVER_WEXT_SUPPORT
	bool "Enable support for the older deprecated WEXT driver"
	default n

config MANA_DRIVER_11N_SUPPORT
        bool "Enable 802.11N support"
        default y

config MANA_DRIVER_11AC_SUPPORT
        bool "Enable 802.11AC support"
        default y

config MANA_DRIVER_11W_SUPPORT
        bool "Enable 802.11W (Management Frame Protection)"
        default y

config MANA_DRIVER_TAXONOMY_SUPPORT
        bool "Enable Taxonomy support for hostapd-mana"
        default y
```
